## Kconfig
```kconfig
menu "LIMITZ MAX-6921 VFD Driver"

	choice LMTZ_MAX6921_SPI
		prompt "SPI host"
		default LMTZ_MAX6921_SPI_HSPI

		config LMTZ_MAX6921_SPI_HSPI
			bool "HSPI / SPI2)"
		
		config LMTZ_MAX6921_SPI_VSPI
			bool "VSPI / SPI3"
	endchoice

	config LMTZ_MAX6921_CLOCK_SPEED
		int
		prompt "SPI Clock speed"
		default 1000000
	
	config LMTZ_MAX6921_SPI_USE_GPIO
		bool  "SPI uses GPIO matrix pins"
		default y

	config LMTZ_MAX6921_PIN_MOSI
		depends on LMTZ_MAX6921_SPI_USE_GPIO
		int "SPI: MOSI/DIN pin"
		default 23

	config LMTZ_MAX6921_PIN_MISO
		depends on LMTZ_MAX6921_SPI_USE_GPIO
		int "SPI: MISO/DOUT pin"
		default 19

	config LMTZ_MAX6921_PIN_SCK
		depends on LMTZ_MAX6921_SPI_USE_GPIO
		int "SPI: SCK pin"
		default 18

	config LMTZ_MAX6921_PIN_CS
		depends on LMTZ_MAX6921_SPI_USE_GPIO
		int "SPI: CS/LOAD pin"
		default 5

	config LMTZ_MAX6921_PIN_EN
		int "Optional: EN pin"
		default 0


	

endmenu
```
